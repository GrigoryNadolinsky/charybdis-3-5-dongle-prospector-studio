## config/west.yml
```yaml
manifest:
  remotes:
    - name: zmkfirmware
      url-base: https://github.com/zmkfirmware
    - name: grigorynadolinsky
      url-base: https://github.com/GrigoryNadolinsky
    - name: carrefinho                            # <--- add this
      url-base: https://github.com/carrefinho     # <--- and this
  projects:
    - name: zmk
      remote: zmkfirmware
      revision: main
      import: app/west.yml
    - name: zmk-pmw3610-driver-maccel
      remote: grigorynadolinsky
      revision: main
    - name: prospector-zmk-module                 # <--- and these
      remote: carrefinho                          # <---
      revision: main      
  self:
    path: config
```
